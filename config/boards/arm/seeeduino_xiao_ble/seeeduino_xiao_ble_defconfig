## config/boards/arm/seeeduino_xiao_ble/seeeduino_xiao_ble_defconfig
```kconfig
CONFIG_SOC_SERIES_NRF52X=y CONFIG_SOC_NRF52840_QIAA=y
CONFIG_BOARD_SEEEDUINO_XIAO_BLE=y
CONFIG_GPIO=y CONFIG_SERIAL=y CONFIG_CONSOLE=y
CONFIG_ZMK_USB=y CONFIG_USB_DEVICE_STACK=y
```
